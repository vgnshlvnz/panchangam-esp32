## firmware/main/Kconfig.projbuild
```kconfig
menu "Panchangam Configuration"

    config PANCH_WIFI_SSID
        string "Wi-Fi SSID"
        default ""

    config PANCH_WIFI_PASSWORD
        string "Wi-Fi password"
        default ""

    config PANCH_SLACK_WEBHOOK_URL
        string "Slack Incoming Webhook URL"
        default ""
        help
            Secret. Set it in menuconfig; sdkconfig is gitignored.

    config X_OAUTH1_CONSUMER_KEY
        string "X OAuth 1.0a API key (consumer key)"
        default ""
        help
            Secret. Set it in menuconfig; sdkconfig is gitignored. All four
            OAuth 1.0a values must be set, or X is skipped.

    config X_OAUTH1_CONSUMER_SECRET
        string "X OAuth 1.0a API secret (consumer secret)"
        default ""
        help
            Secret. Set it in menuconfig; sdkconfig is gitignored. All four
            OAuth 1.0a values must be set, or X is skipped.

    config X_OAUTH1_ACCESS_TOKEN
        string "X OAuth 1.0a access token"
        default ""
        help
            Secret. Set it in menuconfig; sdkconfig is gitignored. All four
            OAuth 1.0a values must be set, or X is skipped.

    config X_OAUTH1_ACCESS_TOKEN_SECRET
        string "X OAuth 1.0a access token secret"
        default ""
        help
            Secret. Set it in menuconfig; sdkconfig is gitignored. All four
            OAuth 1.0a values must be set, or X is skipped.

    config X_OAUTH2_CLIENT_ID
        string "X OAuth 2.0 client id (unused for now)"
        default ""

    config X_OAUTH2_CLIENT_SECRET
        string "X OAuth 2.0 client secret (unused for now)"
        default ""
        help
            Secret. Stored for future use; not used yet.

    config PANCH_POST_HOUR
        int "Daily post hour (MYT)"
        range 0 23
        default 5

    config PANCH_POST_MINUTE
        int "Daily post minute"
        range 0 59
        default 30

    config PANCH_POST_AT_BOOT
        bool "Post once right after time sync (connectivity test)"
        default n

    # Firmware choice (the Python core has no default location); Kuala Lumpur
    # matches the test fixtures.
    config PANCH_LATITUDE_MDEG
        int "Latitude (millidegrees, north positive)"
        default 3141

    config PANCH_LONGITUDE_MDEG
        int "Longitude (millidegrees, east positive)"
        default 101686

    config PANCH_ELEVATION_M
        int "Elevation (m)"
        default 56

endmenu
```
